## board/terramaster/f2nas2/Kconfig
```kconfig
if TARGET_F2NAS2

config SYS_BOARD
	default "f2nas2"

config SYS_VENDOR
	default "terramaster"

config SYS_CONFIG_NAME
	default "f2nas2"

endif
```

## configs/f2nas2_defconfig
```kconfig
CONFIG_ARM=y
CONFIG_KIRKWOOD=y
CONFIG_TARGET_F2NAS2=y
CONFIG_SYS_EXTRA_OPTIONS="F2NAS2"
# CONFIG_CMD_IMLS is not set
# CONFIG_CMD_FLASH is not set
# CONFIG_CMD_SETEXPR is not set
CONFIG_NET_RANDOM_ETHADDR=y
CONFIG_SPI_FLASH=y
```
